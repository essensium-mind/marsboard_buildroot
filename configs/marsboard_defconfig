## configs/marsboard_defconfig
```kconfig
BR2_arm=y
BR2_cortex_a9=y
BR2_KERNEL_HEADERS_VERSION=y
BR2_DEFAULT_KERNEL_VERSION="3.10.52"
BR2_PACKAGE_HOST_LINUX_HEADERS_CUSTOM_3_10=y
BR2_TOOLCHAIN_BUILDROOT_GLIBC=y
BR2_GLIBC_VERSION_2_21=y
BR2_BINUTILS_VERSION_2_25=y
BR2_GCC_VERSION_4_9_X=y
# BR2_TARGET_GENERIC_GETTY is not set
BR2_SYSTEM_DHCP="eth0"
BR2_ROOTFS_OVERLAY="board/embest/marsboard/fs-overlay"
BR2_ROOTFS_POST_BUILD_SCRIPT="board/embest/marsboard/post-build.sh"
BR2_LINUX_KERNEL=y
BR2_LINUX_KERNEL_CUSTOM_GIT=y
BR2_LINUX_KERNEL_CUSTOM_REPO_URL="https://github.com/essensium-mind/marsboard_linux.git"
BR2_LINUX_KERNEL_CUSTOM_REPO_VERSION="kk4.4.3_2.0.0-ga_marsboard"
BR2_LINUX_KERNEL_DEFCONFIG="marsboard"
BR2_LINUX_KERNEL_ZIMAGE=y
BR2_LINUX_KERNEL_DTS_SUPPORT=y
BR2_LINUX_KERNEL_INTREE_DTS_NAME="imx6q-marsboard"
BR2_LINUX_KERNEL_INSTALL_TARGET=y
BR2_PACKAGE_DROPBEAR=y
BR2_TARGET_ROOTFS_EXT2=y
BR2_TARGET_ROOTFS_EXT2_4=y
BR2_TARGET_ROOTFS_EXT2_LABEL="root"
BR2_TARGET_UBOOT=y
BR2_TARGET_UBOOT_BOARDNAME="marsboard"
BR2_TARGET_UBOOT_CUSTOM_GIT=y
BR2_TARGET_UBOOT_CUSTOM_REPO_URL="https://github.com/essensium-mind/marsboard_uboot.git"
BR2_TARGET_UBOOT_CUSTOM_REPO_VERSION="2015.01_marsboard"
BR2_TARGET_UBOOT_FORMAT_IMX=y
BR2_PACKAGE_HOST_UBOOT_TOOLS=y
```
